## main/Kconfig.projbuild
```kconfig
# put here your custom config value
menu "House Monitor Config"
config ESP_WIFI_SSID
    string "WiFi SSID"
    default "myssid"
    help
	SSID (network name) for the example to connect to.

config ESP_WIFI_PASSWORD
    string "WiFi Password"
    default "mypassword"
    help
	WiFi password (WPA or WPA2) for the example to use.

config ESP_MAXIMUM_RETRY
	int "Max number of retry events"
	default 5
	help
	Maximum number of retry events

config I2C_POLL_PERIOD
    int "How often (in ms) should we request for data samples"
    default 5000
    help
	    Pressure, Temp, and RH sensor poll rate.  Faster will induce self-heating.

config I2C_CMD_TIMEOUT
    int "How long (ms) should we wait before assuming a I2C command failed"
    default 200
    help
	    Timeout, in ms, to wait before assuming a I2C command errored out

config MQTT_BROKER_URL
    string "MQTT Broker URL"
    default "mqtt://mqtt.eclipse.org"
    help
	    MQTT Dial string. Something like mqtt://username:password@mqtt.eclipse.org:1884

config MQTT_CLIENT_ID
    string "MQTT Client ID"
    default NULL
    help
	    Sets the mqtt client id.  Default is to use ESP_<last3ofmac>

config MQTT_TOPIC_WEATHER
    string "MQTT weather topic to publish to"
    default "sensor/wx"
    help
	    MQTT topic to publish weather sensor data to

config MQTT_TOPIC_POWER
    string "MQTT power topic to publish to"
    default "sensor/power"
    help
	    MQTT topic to publish power data to

config MQTT_TOPIC_HEARTBEAT
    string "MQTT heartbeat topic to publish to"
    default "heartbeat/wxpwr"
    help
	    MQTT topic to public heartbeat millis clock

config MQTT_TOPIC_HEARTBEAT_PERIOD
    int "how often to report heartbeat message (ms)"
    default 5000
    help
	    How often to publish the heartbeat message

config MQTT_LWT_TOPIC
    string "MQTT last will and testement"
    default "lwt/wxpwr"
    help
	    MQTT last will and testement topic

config MQTT_LWT_MESSAGE
    string "MQTT last will and testement message"
    default "i r ded"
    help
	    MQTT last will and testement message

config ATM90E32_LINE_FREQ
    int "Line freq constant"
    default 4485
    help
        Calibration settings - 
        Use 4485 for 60 Hz (North America)
        Use 389 for 50 hz (rest of the world)

config ATM90E32_PGAGAIN
    int "PGA Gain"
    default 21
    help
        PGA Gain.  This depends on the expected current load
        - 0 for 10A (1x)
        - 21 for 100A (2x)
        - 42 for between 100A - 200A (4x)

config ATM90E32_TRANSFORMER_VOLTAGE_GAIN
    int "Calibration constant for various different AC transforms to derive voltage"
    default 37106
    help
        Various calibration constants for the different styles of transformers.
        For meter <= v1.3:
            - 42080 - 9v AC Transformer -  Jameco 112336
            - 32428 - 12v AC Transformer - Jameco 167151
        For meter > v1.4:
            - 37106 - 9v AC Transformer -  Jameco 157041
            - 38302 - 9v AC Transformer -  Jameco 112336
            - 29462 - 12v AC Transformer - Jameco 167151

config ATM90E32_CURRENT_GAIN
    int "Calibration constant for the different current tap sensors"
    default 39473
    help
        This sets the current gain for the different set of current taps.
            
            - 25498 - SCT-013-000 100A/50mA
            - 39473 - SCT-016 120A/40mA
            - 46539 - Magnalab 100A

endmenu
```
